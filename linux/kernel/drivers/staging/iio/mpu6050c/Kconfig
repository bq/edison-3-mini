## linux/kernel/drivers/staging/iio/mpu6050c/Kconfig
```kconfig
#
# Industrial I/O subsystem configuration
#
menu "IIO staging drivers"
	depends on IIO

source "drivers/staging/iio/mpu6050c/inv_compass/Kconfig"
source "drivers/staging/iio/mpu6050c/inv_mpu/Kconfig"
source "drivers/staging/iio/mpu6050c/inv_test/Kconfig"
endmenu
```

## linux/kernel/drivers/vibrator/Kconfig
```kconfig
config MALATA_VIBRATOR
        bool "vibrator driver"
        default n
        help
          This option enables to support vibrator.
```

## linux/modules/drivers/input/touchscreen/gt9xx/Kconfig
```kconfig
config TOUCHSCREEN_GOODIX_GT9XX
	tristate "Goodix I2C Touchscreen"
	depends on I2C && INPUT
	help
	  Say Y here if you have Goodix GT9xx series I2C touch screen,
	  such as gt911, connected to your system.

	  If unsure, say N.

	  To compile this driver as a module, choose M here: the
	  module will be called gt9xx_ts.


config TOUCHSCREEN_E8005
	tristate "for E8005 touchscreen"
	depends on I2C && INPUT
	default n
	help
		Say Y here if you have a R69001 touchscreen
		If unsure, say N.
```

## linux/modules/wlan/realtek/Kconfig
```kconfig
config RTL8723AS
	tristate "Realtek 8723A SDIO or SPI WiFi"
	---help---
	  Help message of RTL8723AS

config RTL8723BS
	tristate "Realtek 8723B SDIO or SPI WiFi"
	---help---
	  Help message of RTL8723BS

config RTL8189ES
	tristate "Realtek 8189ES SDIO or SPI WiFi"
	---help---
	  Help message of RTL8189ES

config WLAN_SDIO
	bool "Enable SDIO interface for Realtek"
	depends on RTL8723AS || RTL8723BS || RTL8189ES
	default n
	---help---
	  Use memory preallocated in platform
```
